// These arguments were used when this file was generated. They will be automatically applied on subsequent loads 
// via the GUI or CLI invocations. Run CLI with '--help' for additional information on how to override these arguments.
// @cliArgs --board "/ti/boards/MSP_EXP432E401Y" --product "simplelink_msp432e4_sdk@3.40.00.08"
// @versions {"data":"2019103101","timestamp":"2019103101","tool":"1.3.1030","templates":"2019103101"}

var RTOS = scripting.addModule("/ti/drivers/RTOS");
var Display = scripting.addModule("/ti/display/Display");
var Display1 = Display.addInstance();
var UART = scripting.addModule("/ti/drivers/UART", {}, false);
var SlNet = scripting.addModule("/ti/net/SlNet");
var SlNet1 = SlNet.addInstance();
var General = scripting.addModule("/ti/ndk/General");
var UART1 = UART.addInstance();
// Name
RTOS.timer0.resource.$name = "MyTimer1";
// Name - The C/C++ identifier used in applications as the index parameter passed to Display runtime APIs
Display1.$name = "CONFIG_Display_0";
// Use Hardware - Select the hardware to use, or 'None' to use available header pins
Display1.$hardware = system.deviceData.board.components.XDS110UART;
var Board = scripting.addModule("/ti/drivers/Board", {}, false);
var DriverLib = scripting.addModule("/ti/devices/DriverLib", {}, false);
// Name - The C/C++ identifier used in applications as the index parameter passed to UART runtime APIs
Display1.uart.$name = "CONFIG_UART_0";
var Power = scripting.addModule("/ti/drivers/Power", {}, false);
// Name
Display1.uart.uart.$name = "MyUART1";
// Use Peripheral
Display1.uart.uart.$assign = "UART0";
// Assign pin
Display1.uart.uart.txPin.$assign = "expansion.76"; // PA1
// Assign pin
Display1.uart.uart.rxPin.$assign = "expansion.74"; // PA0
// Name
SlNet1.$name = "CONFIG_SLNET_0";
// ID - SLNETIF_ID_? value
SlNet1.id = 2;
// Enable Secure Sockets - Enable secure sockets
SlNet1.enableSecureSocks = false;
// Stack Thread Stack Size - Stack size, in bytes, of the generated NDK task ndkStackThread()
General.ndkThreadStkSize = 2048;
// Low Priority Tasks Default Stack Size - Set the default stack size, in bytes, for low priority NDK tasks.
General.lowPriTaskDefStkSize = 2048;
// Normal Priority Tasks Default Stack Size - Set the default stack size, in bytes, for normal priority NDK tasks.
General.normPriTaskDefStkSize = 2048;
// High Priority Tasks Default Stack Size - Set the default stack size, in bytes, for high priority NDK tasks.
General.highPriTaskDefStkSize = 2048;
// Network Open Hook - User defined hook function to run inside the NDK Network Start callback function, networkOpen().
General.networkOpenHook = "netOpenHook";
// Network IP Address Hook - User defined hook function to run in the NDK Network IP address callback function, NetworkIPAddr().
General.networkIPAddrHook = "netIPAddrHook";
// Service Report Hook - User defined hook function to run in the NDK status report callback function
General.serviceReportHook = "serviceReportHook";
// TCP Transmit Buffer Size - Default TCP send buffer size (bytes)
General.tcpTxBufSize = 1024;
// TCP Receive Buffer Size (Copy Mode) - Default TCP receive size (bytes)
General.tcpRxBufSize = 1024;
// TCP Receive Size Maximum (Non-Copy Mode) - Default maximum TCP receive size (bytes)
General.tcpRxBufLimit = 2048;
// UDP Receive Buffer Size
General.udpRxBufSize = 2048;
// Name
General.emac.$name = "CONFIG_EMAC_0";
// Name
General.emac.emac.$name = "MyETHERNET1";
var DMA = scripting.addModule("/ti/drivers/DMA", {}, false);
// Name - The C/C++ identifier used in applications as the index parameter passed to UART runtime APIs
UART1.$name = "CONFIG_UART_2";
// Name
UART1.uart.$name = "MyUART2";
// Use Peripheral
UART1.uart.$assign = "UART3";
// Assign pin
UART1.uart.txPin.$assign = "boosterpack2.30"; // PA5
// Assign pin
UART1.uart.rxPin.$assign = "boosterpack2.29"; // PA4
// Suggest solution
RTOS.timer0.resource.$suggestSolution = "Timer0";
// Suggest solution
General.emac.emac.$suggestSolution = "ETHERNET0";
// Suggest solution
General.emac.emac.led0Pin.$suggestSolution = "63";
// Suggest solution
General.emac.emac.led1Pin.$suggestSolution = "61";
